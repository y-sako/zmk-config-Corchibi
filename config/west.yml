## config/west.yml
```yaml
manifest:
  remotes:
    - name: zmkfirmware
      url-base: https://github.com/zmkfirmware
    - name: yuchamichami
      url-base: https://github.com/yuchamichami
    - name: badjeff
      url-base: https://github.com/badjeff
    - name: nuovotaka
      url-base: https://github.com/nuovotaka
  projects:
    - name: zmk-input-processor-report-rate-limit
      remote: badjeff
      revision: b056cb1~1
    - name: zmk-pointing-acceleration-alpha
      remote: nuovotaka
      revision: main
    - name: zmk
      remote: zmkfirmware
      revision: 354cff9
      import: app/west.yml
  self:
    path: config
```
